## conf/Image.its
```
/dts-v1/;

/ {
    description = "Unsigned U-boot image for Pixel C";
    #address-cells = <1>;

    images {
        kernel@1 {
            description = "Pixel C kernel";
            data = /incbin/("./Image.lz4");
            type = "kernel_noload";
            arch = "arm64";
            os = "android";
            compression = "lz4";
        };
        fdt@1 {
            description = "Flattened Device Tree blob";
            data = /incbin/("./tegra210-smaug.dtb");
            type = "flat_dt";
            arch = "arm64";
            compression = "none";
            hash@1 {
                algo = "sha1";
            };
        };
    };
    configurations {
        default = "conf@1";
        conf@1 {
            description = "Pixel C kernel image with FDTB";
            kernel = "kernel@1";
            fdt = "fdt@1";
        };
    };
};
```
